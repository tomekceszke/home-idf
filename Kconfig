## Kconfig
```kconfig
menu "home-idf"

    config HOME_IDF_WIFI_RETRY_MAX_S
        int "Maximum WiFi reconnect backoff (s)"
        default 60
        range 2 3600

    config HOME_IDF_WIFI_ROAM_CHECK_S
        int "WiFi roam check period (s), 0 = off"
        default 300
        range 0 3600
        help
            When an AP drops out for a moment, its stations join another one and stay there after it is back.
            While the signal is weak, a background scan every this many seconds looks for a stronger AP.

    config HOME_IDF_WIFI_ROAM_RSSI
        int "Scan for a stronger AP below this signal (dBm)"
        default -75
        range -95 -40

    config HOME_IDF_WIFI_ROAM_MIN_GAIN_DB
        int "Reconnect when another AP is this much stronger (dB)"
        default 10
        range 3 40

    config HOME_IDF_WIFI_RESET_AFTER_S
        int "Restart the WiFi driver after this long offline (s), 0 = never"
        default 900
        range 0 86400
        help
            Restarts only the WiFi driver (esp_wifi_stop/start), not the device, so the application keeps its
            state. Repeats at the same interval while the outage lasts.

    config HOME_IDF_AUTH_MAX_SESSIONS
        int "Stored web sessions"
        default 4
        range 1 16
        help
            Sessions are persisted in NVS as one blob; the oldest is evicted when full.

    config HOME_IDF_NOTIFY_TASK_STACK
        int "Notification task stack (bytes)"
        default 6144

    config HOME_IDF_OTA_TASK_STACK
        int "Background OTA task stack (bytes)"
        default 8192

    config HOME_IDF_MQTT
        bool "MQTT client (telemetry, retained status and state topics)"
        default n
        help
            Publishes to <prefix>/<mac>/<kind> on the local broker, with a retained status topic used as
            the LWT and an optional retained state topic carrying the device's full status JSON.

    config HOME_IDF_MIGRATOR
        bool "OTA migrator (rewrites bootloader and partition table of a legacy device)"
        default n
        depends on SPI_FLASH_DANGEROUS_WRITE_ALLOWED
        help
            Only for a dedicated one-shot migrator image. Requires CONFIG_SPI_FLASH_DANGEROUS_WRITE_ALLOWED.

endmenu
```

## examples/minimal/sdkconfig.defaults
```kconfig
CONFIG_IDF_TARGET="esp32"
CONFIG_ESPTOOLPY_FLASHSIZE_4MB=y
CONFIG_PARTITION_TABLE_TWO_OTA=y
CONFIG_BOOTLOADER_APP_ROLLBACK_ENABLE=y
CONFIG_COMPILER_OPTIMIZATION_SIZE=y
CONFIG_ESP_WIFI_11KV_SUPPORT=y
CONFIG_ESP_PHY_REDUCE_TX_POWER=y
CONFIG_ESP_WIFI_SOFTAP_SUPPORT=n
CONFIG_LWIP_IPV6=n
CONFIG_HTTPD_MAX_REQ_HDR_LEN=1024
```
